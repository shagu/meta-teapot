## conf/distro/teapot.conf
```bitbake
##
# Distribution definition for: teapot

DISTRO = "teapot"
DISTRO_NAME = "teapot mainline distribution"
DISTRO_VERSION = "2018"
DISTRO_FEATURES_append = "zeroconf alsa pulseaudio wifi"

TARGET_VENDOR = "-teapot"

TEAPOT_ROOT_PASS ??= '\$6\$wixdy8pV\$Dfgu6z1oj2iXI9sWrUZptm7CGea//P0h1OYKLjBiYYJAMj/R/hWXi.WuyFWt2aPpdNInINeRxS0lk4y2Xvx/5.'
TEAPOT_WIFI_SSID ??= 'ssid'
TEAPOT_WIFI_PASS ??= 'password'

PACKAGE_CLASSES = "package_ipk"

IMAGE_CLASSES += "sdcard"
IMAGE_FSTYPES = "tar.gz ext4 sdcard"

KERNEL_IMAGETYPE ?= "uImage"
UBOOT_SCRIPT ?= "boot.scr"

GLIBC_GENERATE_LOCALES = "en_GB.UTF-8 en_US.UTF-8"
IMAGE_LINGUAS ?= "en-gb"

## Preferred packages
PREFERRED_PROVIDER_virtual/kernel ?= "linux-stable"
PREFERRED_PROVIDER_virtual/bootloader ?= "u-boot"

## Image Features
EXTRA_IMAGE_FEATURES = "debug-tweaks"
IMAGE_NAME = "${IMAGE_BASENAME}-${MACHINE}"

## Accept Licenses
ACCEPT_FSL_EULA = "1"
LICENSE_FLAGS_WHITELIST += "commercial"
```

## conf/layer.conf
```bitbake
# We have a conf and classes directory, add to BBPATH
BBPATH .= ":${LAYERDIR}"

# We have recipes-* directories, add to BBFILES
BBFILES += "${LAYERDIR}/recipes-*/*/*.bb ${LAYERDIR}/recipes-*/*/*.bbappend"

BBFILE_COLLECTIONS += "teapot"
BBFILE_PATTERN_teapot = "^${LAYERDIR}/"
BBFILE_PRIORITY_teapot = "99"

# This should only be incremented on significant changes that will
# cause compatibility issues with other layers
LAYERVERSION_teapot = "1"

LAYERDEPENDS_teapot = "core"
```

## conf/machine/armv7.conf
```bitbake
#@TYPE: Machine
#@NAME: armv7a multiarch
#@DESCRIPTION: Machine configuration for a generic armv7a

include conf/machine/include/arm/arch-armv7a.inc
DEFAULTTUNE = "armv7a-neon"

PREFERRED_PROVIDER_virtual/kernel = "linux-stable"
PREFERRED_PROVIDER_virtual/bootloader = "u-boot"
PREFERRED_PROVIDER_virtual/xserver = "xserver-xorg"

KERNEL_IMAGETYPE = "zImage"

KERNEL_DEVICETREE = "omap4-panda.dtb"

#UBOOT_ENTRYPOINT = "0x0"
#UBOOT_LOADADDRESS = "0x0"
UBOOT_MACHINE = "dummy_config"

EXTRA_IMAGEDEPENDS += "u-boot"

IMAGE_FSTYPES = "tar.gz ext4"

SERIAL_CONSOLE = "115200 ttyO2"

MACHINE_FEATURES = "kernel26 wifi alsa apm usbgadget usbhost vfat"
```

## conf/machine/bananapi.conf
```bitbake
#@TYPE: Machine
#@NAME: Bananapi
#@DESCRIPTION: Machine configuration for the bananapi, based on allwinner A20 CPU http://bananapi.org/

require conf/machine/include/tune-cortexa7.inc

SOC_FAMILY = "sun7i"
SUNXI_FEX_FILE = "sys_config/a20/Bananapi.fex"

UBOOT_MACHINE = "Bananapi_config"
UBOOT_ENTRYPOINT ?= "0x40008000"
UBOOT_LOADADDRESS ?= "0x400080OB00"

SPL_BINARY="u-boot-sunxi-with-spl.bin"

SDIMG_SPL = "u-boot-sunxi-with-spl.bin"
SDIMG_SPL_OFFSET = "8192"

KERNEL_DEVICETREE = "sun7i-a20-bananapi.dtb"

SERIAL_CONSOLE ?= "115200 ttyS0"
MACHINE_FEATURES ?= "alsa apm keyboard rtc serial screen usbgadget usbhost vfat"
```

## conf/machine/beaglebone.conf
```bitbake
#@TYPE: Machine
#@NAME: beaglebone machine
#@DESCRIPTION: Machine configuration for the am335x beaglebone black

DEFAULTTUNE = "armv7a-neon"
include conf/machine/include/arm/arch-armv7a.inc

UBOOT_MACHINE = "am335x_evm_config"
UBOOT_ENTRYPOINT = "0x80008000"
UBOOT_LOADADDRESS = "0x80008000"
UBOOT_SCRIPT = "uEnv.txt"

SPL_BINARY = "MLO"

SDIMG_BOOTFILES += " \
    MLO \
    u-boot.img \
  "

KERNEL_DEVICETREE = "am335x-boneblack.dtb"
KERNEL_DEFCONFIG = "omap2plus"
KERNEL_EXTRA_ARGS += "LOADADDR=${UBOOT_ENTRYPOINT}"

SERIAL_CONSOLE = "115200 ttyO0"

MACHINE_FEATURES = "kernel26 serial ethernet apm usbgadget usbhost vfat alsa"
```

## conf/machine/cubox.conf
```bitbake
#@TYPE: Machine
#@NAME: CuBox machine
#@DESCRIPTION: Machine configuration for the dove cubox

require conf/machine/include/arm/arch-armv7a.inc

TUNEVALID[marvellpj4] = "Enable Marvell PJ4 specific processor optimizations"
TUNE_CCARGS += "${@bb.utils.contains("TUNE_FEATURES", "marvellpj4", "-mfpu=vfpv3-d16 -mtune=marvell-pj4", "", d)}"

# softfloat
AVAILTUNES += "marvellpj4"
ARMPKGARCH_tune-marvellpj4 ?= "marvellpj4"
TUNE_FEATURES_tune-marvellpj4 ?= "${TUNE_FEATURES_tune-armv7a} marvellpj4"
PACKAGE_EXTRA_ARCHS_tune-marvellpj4 = "${PACKAGE_EXTRA_ARCHS_tune-armv7a} marvellpj4 marvellpj4-vfp"
DEFAULTTUNE ?= "marvellpj4"

## hardfloat
#AVAILTUNES += "marvellpj4hf"
#ARMPKGARCH_tune-marvellpj4hf ?= "marvellpj4"
#TUNE_FEATURES_tune-marvellpj4hf ?= "${TUNE_FEATURES_tune-armv7ahf} marvellpj4"
#PACKAGE_EXTRA_ARCHS_tune-marvellpj4hf = "${PACKAGE_EXTRA_ARCHS_tune-armv7ahf} marvellpj4hf-vfp"
#DEFAULTTUNE ?= "marvellpj4hf"

KERNEL_DEVICETREE = "dove-cubox.dtb"
KERNEL_DEFCONFIG = "dove"

UBOOT_ENTRYPOINT = "0x00008000"
UBOOT_LOADADDRESS = "0x00008000"

SERIAL_CONSOLE = "115200 ttyS0"

MACHINE_FEATURES = "kernel26 serial ethernet"
```

## conf/machine/ecafe.conf
```bitbake
#@TYPE: Machine
#@NAME: eCafe
#@DESCRIPTION: Machine configuration for the Hercules eCafe

require conf/machine/include/tune-cortexa8.inc

SOC_FAMILY = "omap4"

KERNEL_DEVICETREE = "imx51-na04.dtb"
KERNEL_DEFCONFIG = "none"

UBOOT_MACHINE = "mx51_na04_config"
UBOOT_ENTRYPOINT = "0x90008000"
UBOOT_LOADADDRESS = "0x90008000"
UBOOT_SUFFIX = "imx"
UBOOT_SCRIPT = "uEnv.txt"

SDIMG_SPL = "u-boot.imx"
SDIMG_SPL_OFFSET = "1024"
SDIMG_BOOTFILES += " \
    boot.ini \
  "

GUI_MACHINE_CLASS = "bigscreen"

SERIAL_CONSOLE = "115200 ttymxc0"

MACHINE_FEATURES = "kernel26 wifi alsa apm screen usbhost vfat"
```

## conf/machine/orangepizero.conf
```bitbake
#@TYPE: Machine
#@NAME: orangepizero
#@DESCRIPTION: Machine configuration for the orange pi zero, based on allwinner H3 CPU

SOC_FAMILY = "sun8i"
include conf/machine/include/soc-family.inc
require conf/machine/include/tune-cortexa7.inc

# Sub-architecture support
MACHINE_SOCARCH_SUFFIX_sun4i = "-sun4i"

UBOOT_MACHINE = "orangepi_zero_defconfig"
UBOOT_ENTRYPOINT ?= "0x40008000"
UBOOT_LOADADDRESS ?= "0x400080OB00"

SPL_BINARY ?= "u-boot-sunxi-with-spl.bin"

SDIMG_SPL = "${SPL_BINARY}"
SDIMG_SPL_OFFSET = "8192"

SERIAL_CONSOLE ?= "115200 ttyS0"
MACHINE_FEATURES ?= "alsa apm keyboard rtc serial screen usbgadget usbhost vfat"

KERNEL_DEVICETREE = "sun8i-h2-plus-orangepi-zero.dtb"
```

## conf/machine/pandaboard.conf
```bitbake
#@TYPE: Machine
#@NAME: Pandaboard
#@DESCRIPTION: Machine configuration for the OMAP4430 Panda

require conf/machine/include/soc-family.inc
require conf/machine/include/tune-cortexa9.inc

SOC_FAMILY = "omap4"

KERNEL_DEVICETREE = "omap4-panda.dtb"
KERNEL_DEFCONFIG = "omap2plus"

UBOOT_MACHINE = "omap4_panda_config"
UBOOT_ENTRYPOINT = "0x80008000"
UBOOT_LOADADDRESS = "0x80008000"
UBOOT_SUFFIX = "img"
UBOOT_SCRIPT = "uEnv.txt"

SPL_BINARY = "MLO"

SDIMG_BOOTFILES += " \
    u-boot.img \
    MLO \
  "

GUI_MACHINE_CLASS = "bigscreen"

SERIAL_CONSOLE = "115200 ttyO2"

MACHINE_FEATURES = "kernel26 wifi bluetooth alsa apm ext2 screen usbgadget usbhost vfat sgx"
```

## conf/machine/raspberrypi.conf
```bitbake
#@TYPE: Machine
#@NAME: RaspberryPi Development Board (Mainline)
#@DESCRIPTION: Machine configuration for the RaspberryPi http://www.raspberrypi.org/ Board

require conf/machine/include/arm/arch-armv6.inc

DEFAULTTUNE ?= "armv6"
TUNEVALID[arm1176jzfs] = "Enable arm1176jzfs specific processor optimizations"
TUNE_CCARGS += "${@bb.utils.contains("TUNE_FEATURES", "arm1176jzfs", "-mtune=arm1176jzf-s", "", d)}"
TUNE_CCARGS += "${@bb.utils.contains("TUNE_FEATURES", "vfp", "-mfpu=vfp", "", d)}"

AVAILTUNES += "arm1176jzfs arm1176jzfshf"
TUNE_FEATURES_tune-arm1176jzfs = "${TUNE_FEATURES_tune-armv6} arm1176jzfs"
TUNE_FEATURES_tune-arm1176jzfshf = "${TUNE_FEATURES_tune-arm1176jzfs} callconvention-hard"

ARMPKGARCH_tune-arm1176jzfs = "arm1176jzfs"
ARMPKGARCH_tune-arm1176jzfshf = "arm1176jzfs"

PACKAGE_EXTRA_ARCHS_tune-arm1176jzfs = "${PACKAGE_EXTRA_ARCHS_tune-armv6}"
PACKAGE_EXTRA_ARCHS_tune-arm1176jzfshf = "${PACKAGE_EXTRA_ARCHS_tune-armv6hf-vfp} arm1176jzfshf-vfp"

PREFERRED_PROVIDER_virtual/kernel = "linux-stable"
PREFERRED_PROVIDER_virtual/bootloader = "u-boot"

KERNEL_DEVICETREE = "bcm2835-rpi-b.dtb"
KERNEL_DEFCONFIG = "bcm2835"

UBOOT_MACHINE = "rpi_b_config"
UBOOT_MAKE_TARGET = "u-boot.bin"
UBOOT_SUFFIX = "bin"
UBOOT_SCRIPT = "uEnv.txt"

SDIMG_BOOTFILES += " config.txt \
    bcm2835-bootfiles/bootcode.bin \
    bcm2835-bootfiles/start.elf \
    u-boot.bin \
  "

EXTRA_IMAGEDEPENDS += "bcm2835-bootfiles"

GUI_MACHINE_CLASS = "bigscreen"

SERIAL_CONSOLE = "115200 ttyAMA0"

MACHINE_FEATURES = "kernel26 apm usbhost keyboard vfat ext2 screen alsa wifi sdio"
MACHINE_FEATURES_BACKFILL_CONSIDERED = "rtc"
```

## conf/machine/sheevaplug.conf
```bitbake
#@TYPE: Machine
#@NAME: Sheevaplug
#@DESCRIPTION: Machine configuration for the sheevaplug

require conf/machine/include/tune-arm926ejs.inc

TARGET_ARCH = "arm"

IMAGE_FSTYPES += "tar.gz ubi ext4"
SERIAL_CONSOLE = "115200 ttyS0"

UBOOT_ENTRYPOINT = "0x00008000"
UBOOT_LOADADDRESS = "0x00008000"
```

## conf/machine/wandboard.conf
```bitbake
#@TYPE: Machine
#@NAME: Wandboard
#@DESCRIPTION: Machine configuration for the i.MX6 Wandboard

require conf/machine/include/tune-cortexa9.inc

KERNEL_DEVICETREE = "imx6q-wandboard.dtb"
KERNEL_DEFCONFIG = "imx_v6_v7"

UBOOT_MACHINE = "wandboard_quad_config"
UBOOT_ENTRYPOINT = "0x10008000"
UBOOT_LOADADDRESS = "0x10008000"
UBOOT_MAKE_TARGET = "u-boot.imx"
UBOOT_SUFFIX = "imx"

SDIMG_SPL = "u-boot-wandboard.imx"
SDIMG_SPL_OFFSET = "1024"

GUI_MACHINE_CLASS = "bigscreen"

SERIAL_CONSOLE = "115200 ttymxc0"

MACHINE_FEATURES = "kernel26 alsa apm ext2 screen usbgadget usbhost vfat wifi pci"
```
